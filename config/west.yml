## config/west.yml
```yaml
manifest:
  remotes:
    - name: moergo-sc
      url-base: https://github.com/clearskystudio
  projects:
    - name: zmk
      remote: moergo-sc
      revision: main
      import: app/west.yml
  self:
    path: config
```
